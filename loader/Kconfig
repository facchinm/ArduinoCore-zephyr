## loader/Kconfig
```kconfig
#
# Copyright (c) Arduino s.r.l. and/or its affiliated companies
#
# SPDX-License-Identifier: Apache-2.0
#

config PINCTRL
	select PINCTRL_NON_STATIC

config USB_CONFIGURATION_STRING_DESC
	default "$(APP_VERSION_EXTENDED_STRING)"

source "Kconfig.zephyr"

config LOADER_STATIC_ONLY
        bool "Only run statically linked sketches"
        help
          Do not load ELF sketches at runtime, saving the LLEXT loader code.
          The LLEXT export table is still built to generate the symbol scripts.

config LLEXT_HEAP_REGION
	string "LLEXT heap memory region"
	depends on CODE_DATA_RELOCATION
	help
	  Specify the memory region for LLEXT heap.

config MAIN_STACK_REGION
	string "Main stack memory region"
	depends on CODE_DATA_RELOCATION
	help
	  Specify the memory region for main stack.

rsource "ota/Kconfig"
```
